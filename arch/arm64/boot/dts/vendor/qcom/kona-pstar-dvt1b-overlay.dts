/* Copyright (c) 2019, The Linux Foundation. All rights reserved.
 *
 * This program is free software; you can redistribute it and/or modify
 * it under the terms of the GNU General Public License version 2 and
 * only version 2 as published by the Free Software Foundation.
 *
 * This program is distributed in the hope that it will be useful,
 * but WITHOUT ANY WARRANTY; without even the implied warranty of
 * MERCHANTABILITY or FITNESS FOR A PARTICULAR PURPOSE.  See the
 * GNU General Public License for more details.
 */

/dts-v1/;
/plugin/;

#include "kona-pstar-common-overlay.dtsi"

/ {
	model = "pstar";
	compatible = "qcom,kona-pstar", "qcom,kona-moto", "qcom,kona";
	qcom,msm-id = <356 0x20001>;
	qcom,board-id = <0 0xB1B0>;
};


&front_main {
	rgltr-min-voltage = <1800000 2800000 1104000 0>;
	rgltr-max-voltage = <1800000 2800000 1104000 0>;
	rgltr-load-current = <19800 53000 105000 0>;
};
