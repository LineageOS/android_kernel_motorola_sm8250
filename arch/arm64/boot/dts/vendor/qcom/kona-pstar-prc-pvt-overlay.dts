/* Copyright (c) 2021, The Linux Foundation. All rights reserved.
 *
 * This program is free software; you can redistribute it and/or modify
 * it under the terms of the GNU General Public License version 2 and
 * only version 2 as published by the Free Software Foundation.
 *
 * This program is distributed in the hope that it will be useful,
 * but WITHOUT ANY WARRANTY; without even the implied warranty of
 * MERCHANTABILITY or FITNESS FOR A PARTICULAR PURPOSE.  See the
 * GNU General Public License for more details.
 */

/dts-v1/;
/plugin/;

#include "kona-pstar-common-overlay.dtsi"
#include "kona-pstar-battery-prc.dtsi"
#define PSTAR_RADIO_PRC 2

/ {
	model = "pstar";
	compatible = "qcom,kona-pstar", "qcom,kona-moto", "qcom,kona";
	qcom,msm-id = <356 0x20001>;
	qcom,board-id = <(PSTAR_RADIO_PRC << 8 | 0) 0xC000>;
};

&ufsphy_mem {
    vdda-phy-always-on;
};

