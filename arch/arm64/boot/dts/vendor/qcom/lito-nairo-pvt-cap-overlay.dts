/* Copyright (c) 2019, The Linux Foundation. All rights reserved.
 *
 * This program is free software; you can redistribute it and/or modify
 * it under the terms of the GNU General Public License version 2 and
 * only version 2 as published by the Free Software Foundation.
 *
 * This program is distributed in the hope that it will be useful,
 * but WITHOUT ANY WARRANTY; without even the implied warranty of
 * MERCHANTABILITY or FITNESS FOR A PARTICULAR PURPOSE.  See the
 * GNU General Public License for more details.
 */

/dts-v1/;
/plugin/;

#include "lito-nairo-common-overlay.dtsi"

/ {
	model = "nairo";
	compatible = "qcom,lito-nairo", "qcom,lito-moto", "qcom,lito";
	qcom,msm-id = <400 0x10000>, <440 0x10000>;
	qcom,board-id = <(NAIRO_RADIO_VZW << 8 | 0x4D) 0xC000>, <(NAIRO_RADIO_NA << 8 | 0x4D) 0xC000>;
};

&sx933x {
	Semtech,button-flag = <0x03>;
	Semtech,reg-num = <85>;
	Semtech,reg-init =<
		0x8020  0x1f0000
		0x4004  0x7c
		0x4008  0x0
		0x4054  0x400
		0x42c0  0x8000000
		0x42c4  0x3f
		0x800c  0x0
		0x8010  0x0
		0x8014  0x0
		0x8018  0x0
		0x801c  0x31
		0x8024  0x1466
		0x8028  0x3ffe8259
		0x802c  0x1476
		0x8030  0x3fbf82d0
		0x8034  0x1466
		0x8038  0x2fff84cb
		0x803c  0x1466
		0x8040  0x3ff78022
		0x8044  0x1466
		0x8048  0x3dff8022
		0x804c  0x148e
		0x8050  0x80001ee6
		0x8054  0x10223700
		0x8058  0x20630031
		0x805c  0x7f605000
		0x8060  0x0
		0x8064  0x940000
		0x8068  0x0
		0x806c  0x26002600
		0x8070  0x10000
		0x8074  0x10223b00
		0x8078  0x20630031
		0x807c  0x543c5000
		0x8080  0x0
		0x8084  0x860000
		0x8088  0x0
		0x808c  0x0
		0x8090  0x0
		0x8094  0x10222800
		0x8098  0x20630031
		0x809c  0x54ac5000
		0x80a0  0x0
		0x80a4  0x0
		0x80a8  0x0
		0x80ac  0x0
		0x80b0  0x0
		0x80b4  0x10527e00
		0x80b8  0x20630031
		0x80bc  0x54ac5300
		0x80c0  0x0
		0x80c4  0x0
		0x80c8  0x0
		0x80cc  0x0
		0x80d0  0x0
		0x80d4  0x10527e00
		0x80d8  0x20630031
		0x80dc  0x54ac5300
		0x80e0  0x0
		0x80e4  0x0
		0x80e8  0x0
		0x80ec  0x0
		0x80f0  0x0
		0x80f4  0x10162800
		0x80f8  0x20400031
		0x80fc  0x54ac5300
		0x8100  0x0
		0x8104  0x0
		0x8108  0x0
		0x810c  0x0
		0x8110  0x0
		0x8124  0x4000013
		0x8128  0x0
		0x812c  0x0
		0x8130  0x0
		0x8134  0x0
		0x8138  0x0
		0x813c  0x0
		0x8140  0x0
		0x8144  0x0
		0x8148  0x0
		0x814c  0x0
		0x81a4  0x1c40000
		0x8020  0x1f001f
		0x4280  0xf>;
};

