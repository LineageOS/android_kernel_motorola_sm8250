
qcom,lr50-atl-4500mah {
	qcom,profile-revision = <24>;
	/* #4255112_Lenovo_MountainATL_4500mAh_averaged_MasterSlave_Nov4th2019*/
	serialnum = "SB18C66911";
	qcom,max-voltage-uv = <4450000>;
	qcom,fg-cc-cv-threshold-mv = <4440>;
	qcom,nom-batt-capacity-mah = <4500>;
	qcom,batt-id-kohm = <0>;
	qcom,battery-beta = <4250>;
	qcom,therm-room-temp = <100000>;
	qcom,battery-type = "LR50-ATL-4500mah";
	qcom,therm-coefficients = <0x2318 0xd0c 0xdaf7 0xc556 0x848d>;
	qcom,therm-center-offset = <0x70>;
	qcom,therm-pull-up = <100>;
	qcom,rslow-normal-coeffs = <0x29 0xfd 0x9a 0x0b>;
	qcom,rslow-low-coeffs = <0x34 0x05 0x95 0x0b>;
	qcom,checksum = <0x50C3>;
	qcom,gui-version = "PM855GUI - 1.0.0.13";
	qcom,fg-profile-data = [
		 09 00 54 EA
		 51 E5 65 EA
		 66 E5 00 00
		 A4 BD E4 83
		 FD 87 FC 8A
		 DE 9D 46 80
		 14 00 29 FD
		 9A 0B 7E F5
		 63 F2 CE 07
		 32 00 86 EA
		 11 E4 2C DA
		 DA 0B 18 CD
		 66 BC 96 1A
		 7F 02 9A C5
		 60 00 4F 00
		 4B 00 3E 00
		 31 00 32 00
		 36 00 43 00
		 42 00 45 00
		 3B 00 60 00
		 37 00 4C 00
		 55 00 4D 00
		 46 00 87 00
		 69 64 57 00
		 4F 00 43 08
		 60 00 4D 00
		 58 00 62 10
		 55 10 4C 00
		 7E 20 64 40
		 59 58 54 0D
		 48 00 D8 08
		 39 20 6F 14
		 A9 03 10 FD
		 84 1C 57 03
		 8A 05 D2 22
		 39 19 41 43
		 38 5C 14 03
		 67 10 4A 21
		 C5 05 15 0A
		 AC 04 04 1D
		 25 FB F8 04
		 CC 03 28 18
		 BF 23 58 44
		 6F 5A 88 11
		 47 20 B1 EC
		 5C D3 61 CD
		 EC 1C 2F B3
		 2C 05 92 BB
		 0F 18 88 8B
		 C3 84 08 A2
		 83 A0 09 80
		 23 DA AE 05
		 5E F3 19 03
		 00 00 61 AD
		 25 E3 F5 07
		 E7 E2 5B 8C
		 35 10 12 E0
		 10 CC DC 02
		 DD 04 24 01
		 CE 07 32 00
		 63 01 45 02
		 CF 04 E6 01
		 34 02 F1 05
		 F5 02 6A 05
		 7A 04 57 00
		 36 00 44 00
		 4A 64 4F 00
		 4F 00 4B 08
		 4F 00 4D 00
		 4D 00 49 10
		 42 10 3A 00
		 4C 28 52 50
		 5D 68 6F 08
		 4E 00 57 00
		 5A 08 5A 00
		 3E 00 41 00
		 3A 10 45 10
		 4A 00 5C 28
		 69 48 4D 60
		 53 0D 4E 00
		 46 00 31 08
		 D8 00 47 20
		 05 05 F9 0A
		 CA 0D E0 1C
		 3D 23 B3 45
		 87 5A 40 18
		 5E 03 EC 04
		 DC 03 69 0F
		 3F 0A D9 20
		 13 04 E4 03
		 CE 04 CD 1C
		 0B 03 F2 05
		 43 02 83 18
		 14 02 8D 05
		 01 02 6F 00
		 84 20 75 04
		 A4 03 01 05
		 D6 1C 84 02
		 FC 04 61 03
		 A1 18 86 03
		 63 04 8F 02
		 74 00 76 01
		 C0 00 FA 00
		 29 12 00 00
	];
};
