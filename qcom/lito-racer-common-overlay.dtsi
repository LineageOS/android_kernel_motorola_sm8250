#include <dt-bindings/interrupt-controller/arm-gic.h>
#include "lito-racer-common-overlay-base.dtsi"
//#include "camera/lito-camera-sensor-mot-racer-overlay.dtsi"
#include "lito-racer-audio-overlay.dtsi"

&utags {
	compatible = "mmi,utags";
	mmi,main-utags = "/dev/block/bootdevice/by-name/utags";
	mmi,backup-utags = "/dev/block/bootdevice/by-name/utagsBackup";
};

&hw {
	compatible = "mmi,utags";
	mmi,dir-name = "hw";
	mmi,main-utags = "/dev/block/bootdevice/by-name/hw";
};

