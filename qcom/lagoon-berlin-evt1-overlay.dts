/* Copyright (c) 2019, The Linux Foundation. All rights reserved.
 *
 * This program is free software; you can redistribute it and/or modify
 * it under the terms of the GNU General Public License version 2 and
 * only version 2 as published by the Free Software Foundation.
 *
 * This program is distributed in the hope that it will be useful,
 * but WITHOUT ANY WARRANTY; without even the implied warranty of
 * MERCHANTABILITY or FITNESS FOR A PARTICULAR PURPOSE.  See the
 * GNU General Public License for more details.
 */

/dts-v1/;
/plugin/;

#include <dt-bindings/interrupt-controller/arm-gic.h>
#include "lagoon-berlin-common-overlay.dtsi"
#include "lagoon-moto-kiev-fps-overlay.dtsi"

/ {
	model = "Berlin";
	compatible = "qcom,lagoon-berlin", "qcom,lagoon-moto", "qcom,lagoon";
	qcom,msm-id = <434 0x10000>, <459 0x10000>;
	qcom,board-id = <0x41 0xA100>;
};

