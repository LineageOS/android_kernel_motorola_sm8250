/* Copyright (c) 2019, The Linux Foundation. All rights reserved.
 *
 * This program is free software; you can redistribute it and/or modify
 * it under the terms of the GNU General Public License version 2 and
 * only version 2 as published by the Free Software Foundation.
 *
 * This program is distributed in the hope that it will be useful,
 * but WITHOUT ANY WARRANTY; without even the implied warranty of
 * MERCHANTABILITY or FITNESS FOR A PARTICULAR PURPOSE.  See the
 * GNU General Public License for more details.
 */

/dts-v1/;
/plugin/;

#include "kona-moto-common-overlay.dtsi"

/ {
	model = "Savannah";
	compatible = "qcom,kona-savannah", "qcom,kona-moto", "qcom,kona";
	qcom,msm-id = <356 0x10000>;
	qcom,board-id = <0 0xA100>;
};

/*
 * Savannah HW rev EVT1 specific changes go here
 */
&qupv3_se13_i2c {
	status = "okay";

	goodix_ts_i2c@5d {
		status = "ok";
		compatible = "goodix,goodix_mmi";
		reg = <0x5d>;
		interrupt-parent = <&tlmm>;
		interrupts = <39 0>;
		pinctrl-names = "pmx_ts_active","pmx_ts_suspend";
		pinctrl-0 = <&touch_int_active &touch_reset_active>;
		pinctrl-1 = <&touch_int_suspend &touch_reset_suspend>;
		/*goodix,reg-en-gpio = <&tlmm 120 0x0>;*/
		vtouch-supply = <&pm8150_l13>;
		iovtouch-supply = <&pm8150a_l1>;
		goodix,reset-gpio = <&tlmm 38 0x0>;
		goodix,irq-gpio = <&tlmm 39 0x2002>;
		goodix,irq-flags = <0x2002>; /* 1:trigger rising, 2:trigger falling;*/
		goodix,control-dsi = <0>;
		goodix,panel-max-id = <10>;
		goodix,panel-max-x = <1080>;
		goodix,panel-max-y = <2340>;
		goodix,panel-max-w = <256>;
		goodix,panel-max-p = <4096>;
		goodix,power-on-delay-us = <300000>; /*300ms*/
		goodix,power-off-delay-us = <5000>;
		/*goodix,swap-axis;*/
		goodix,x2x;
		goodix,y2y;
		goodix,pen-enable;
		goodix,usb_charger;
		goodix,key-of-pen = <331 332>;/*BTN_STYLUS, BTN_STYLUS2*/
		goodix,debug-reg-ver = <1>;
	};
};
