/* Copyright (c) 2019, The Linux Foundation. All rights reserved.
 *
 * This program is free software; you can redistribute it and/or modify
 * it under the terms of the GNU General Public License version 2 and
 * only version 2 as published by the Free Software Foundation.
 *
 * This program is distributed in the hope that it will be useful,
 * but WITHOUT ANY WARRANTY; without even the implied warranty of
 * MERCHANTABILITY or FITNESS FOR A PARTICULAR PURPOSE.  See the
 * GNU General Public License for more details.
 */

/dts-v1/;
/plugin/;

#include "kona-moto-common-overlay.dtsi"

/ {
	model = "Burton";
	compatible = "qcom,kona-burton", "qcom,kona-moto", "qcom,kona";
	qcom,msm-id = <356 0x20000>;
	qcom,board-id = <0 0xB100>;
};

/*
 * Burton HW rev DVT1 specific changes go here
 */

&qupv3_se13_i2c {
	goodix_ts_i2c@5d {
		status = "/chosen","mmi,touch","true";
	};
};
