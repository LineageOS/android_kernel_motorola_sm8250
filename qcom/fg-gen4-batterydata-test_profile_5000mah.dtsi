
qcom,test_profile_5000mah_averaged_masterslave_oct30th2019 {
	qcom,profile-revision = <24>;
	/* #Test_Profile_5000mAh_averaged_MasterSlave_Oct30th2019*/
	qcom,max-voltage-uv = <4430000>;
	qcom,nom-batt-capacity-mah = <5000>;
	qcom,batt-id-kohm = <120>;
	qcom,battery-beta = <4250>;
	qcom,therm-room-temp = <100000>;
	qcom,battery-type = "test_profile_5000mah_averaged_masterslave_oct30th2019";
	qcom,therm-coefficients = <0x2318 0xd0c 0xdaf7 0xc556 0x848d>;
	qcom,therm-center-offset = <0x70>;
	qcom,therm-pull-up = <100>;
	qcom,rslow-normal-coeffs = <0x59 0xf5 0xd0 0x1a>;
	qcom,rslow-low-coeffs = <0x55 0x02 0x83 0x1b>;
	qcom,checksum = <0x4B6F>;
	qcom,gui-version = "PM855GUI - 1.0.0.13";
	qcom,fg-profile-data = [
		 09 00 A3 EA
		 8D EC 4E F3
		 3C EC 00 00
		 71 BD D4 8A
		 F8 87 79 93
		 09 94 0F 80
		 0C 00 59 F5
		 D0 1A 62 05
		 0E 02 CE 07
		 32 00 75 EA
		 EE ED AF DB
		 B3 0B 0E E5
		 13 BC 18 2A
		 69 0B 59 D5
		 60 00 45 00
		 42 00 3F 00
		 2F 00 2E 00
		 34 00 47 00
		 3E 00 41 00
		 3D 00 60 00
		 4D 00 5B 00
		 75 00 70 00
		 63 00 DA 00
		 8D 64 72 00
		 68 00 6D 08
		 60 00 7B 00
		 96 00 AB 10
		 9D 10 8F 00
		 FF 28 B2 48
		 95 60 8E 0D
		 97 00 D8 00
		 7C 20 4F 0C
		 88 03 57 FD
		 6A 1C 38 03
		 DA 0D 4B 22
		 1A 17 77 42
		 30 5D 37 02
		 71 10 71 20
		 94 04 56 0B
		 75 05 FC 1C
		 5F 03 9D FC
		 08 02 08 18
		 B5 23 7F 44
		 43 52 82 12
		 12 21 0E E4
		 A0 D3 3B 05
		 FD 1C 55 D9
		 4D 04 76 BA
		 FB 17 6C 8B
		 07 85 85 A3
		 94 98 09 80
		 F4 FB 15 04
		 1F F8 66 F5
		 00 00 CC CD
		 90 02 F8 FF
		 81 E2 92 BC
		 D7 1F 10 F0
		 11 BD B9 03
		 F9 05 BF 03
		 CE 07 32 00
		 8C 01 31 04
		 CB 07 FD 02
		 DD 03 26 04
		 A2 02 A5 04
		 CB 03 5C 00
		 3C 00 42 00
		 44 64 49 00
		 4B 00 40 08
		 46 00 47 00
		 47 00 44 10
		 42 10 43 00
		 54 28 55 48
		 60 60 6F 0C
		 4C 00 51 00
		 5E 08 61 00
		 56 00 44 00
		 44 10 4E 10
		 48 00 5B 20
		 6F 48 49 58
		 56 0E 55 00
		 4B 08 34 10
		 D8 00 6F 20
		 11 05 BD 0A
		 19 0E C0 1C
		 6A 23 BA 45
		 50 52 4D 18
		 3E 02 40 05
		 56 02 6F 10
		 3F 0A 21 20
		 16 05 FD 02
		 BA 05 CC 1C
		 1E 03 DA 05
		 5D 02 99 18
		 CC 03 ED 05
		 24 03 6A 00
		 54 21 DB 05
		 02 02 C1 04
		 EF 1C 1A 02
		 D2 05 62 02
		 B2 18 38 03
		 FF 04 DF 03
		 84 00 86 01
		 C0 00 FA 00
		 4C 13 00 00
	];
};
