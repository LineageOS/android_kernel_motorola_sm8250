/* Copyright (c) 2019, The Linux Foundation. All rights reserved.
 *
 * This program is free software; you can redistribute it and/or modify
 * it under the terms of the GNU General Public License version 2 and
 * only version 2 as published by the Free Software Foundation.
 *
 * This program is distributed in the hope that it will be useful,
 * but WITHOUT ANY WARRANTY; without even the implied warranty of
 * MERCHANTABILITY or FITNESS FOR A PARTICULAR PURPOSE.  See the
 * GNU General Public License for more details.
 */

/dts-v1/;
/plugin/;

#include <dt-bindings/interrupt-controller/arm-gic.h>
#include "lagoon-kiev-common-overlay.dtsi"
#include "lagoon-kiev-jp-vibrator-overlay.dtsi"

#define KIEV_RADIO_JP 5

/ {
	model = "Kiev";
	compatible = "qcom,lagoon-kiev", "qcom,lagoon-moto", "qcom,lagoon";
	qcom,msm-id = <434 0x10000>, <459 0x10000>;
	qcom,board-id = <(KIEV_RADIO_JP <<8 | 0x41) 0xA100>;
};

