/* Copyright (c) 2019, The Linux Foundation. All rights reserved.
 *
 * This program is free software; you can redistribute it and/or modify
 * it under the terms of the GNU General Public License version 2 and
 * only version 2 as published by the Free Software Foundation.
 *
 * This program is distributed in the hope that it will be useful,
 * but WITHOUT ANY WARRANTY; without even the implied warranty of
 * MERCHANTABILITY or FITNESS FOR A PARTICULAR PURPOSE.  See the
 * GNU General Public License for more details.
 */

/dts-v1/;
/plugin/;

#include "lito-nairo-common-overlay.dtsi"

/ {
	model = "nairo";
	compatible = "qcom,lito-nairo", "qcom,lito-moto", "qcom,lito";
	qcom,msm-id = <400 0x10000>, <440 0x10000>;
	qcom,board-id = <(NAIRO_RADIO_VZW << 8 | 0x4D) 0xB1A0>, <(NAIRO_RADIO_NA << 8 | 0x4D) 0xB1A0>;
};

&sx933x {
	Semtech,button-flag = <0x03>;
};

