## drivers/input/touchscreen/focaltech_0flash_mmi/Kconfig
```kconfig
#
# Focaltech Touchscreen driver configuration
#

config INPUT_FOCALTECH_0FLASH_MMI
	tristate "Moto Focaltech Touchscreen"
	depends on I2C
	default n
	help
	  Say Y here if you have Moto Focaltech touch panel.
	  If unsure, say N.

config INPUT_FOCALTECH_0FLASH_MMI_IC_NAME
	string "Focaltech Chip IC Name"
	depends on INPUT_FOCALTECH_0FLASH_MMI
	default ""
	help
	  Set the Focaltech IC name to enable support for specific touch panel chips.
	  If unsure, leave blank.

config INPUT_FOCALTECH_0FLASH_MMI_ENABLE_DOUBLE_TAP
	bool "Moto Focaltech Double tap"
	depends on INPUT_FOCALTECH_0FLASH_MMI
	default n
	help
	  Say Y here to enable support for double tap functionality on Focaltech touch panel.
	  If unsure, say N.

config INPUT_FOCALTECH_0FLASH_MMI_ENABLE_PALM
	bool "Moto Focaltech Palm"
	depends on INPUT_FOCALTECH_0FLASH_MMI
	default n
	help
	  Say Y here to enable support for Palm functionality on Focaltech touch panel.
	  If unsure, say N.

config INPUT_FOCALTECH_0FLASH_MMI_PEN_NOTIFIER
	bool "Moto Focaltech Pen notifier"
	depends on INPUT_FOCALTECH_0FLASH_MMI
	default n
	help
	  Say Y here to enable support for Pen notifier functionality on Focaltech touch panel.
	  If unsure, say N.

config INPUT_FOCALTECH_PANEL_NOTIFICATIONS
	bool "Focaltech Panel Notifications"
	depends on INPUT_FOCALTECH_0FLASH_MMI
	default n
	help
	  Say Y here to enable panel notification support for Focaltech touch panels.
	  If unsure, say N.

config INPUT_FOCALTECH_0FLASH_MMI_ENABLE_ESD
	bool "Moto Focaltech Enable ESD"
	depends on INPUT_FOCALTECH_0FLASH_MMI
	default n
	help
	  Say Y here if you want to have ESD Detection support on Moto Focaltech touch panel.
	  If unsure, say N.
```

## drivers/input/touchscreen/goodix_gtx8_v1430_mmi/Kconfig
```kconfig
#
# Goodix GTx8 Touchscreen driver
#

config TOUCHSCREEN_GOODIX_GTX8_MMI
	tristate "Goodix GTx8 Moto touchpanel driver"
	default n
	help
	  This is the main file for touchpanel driver for Goodix GTx8
	  touchscreens.

	  Say Y here if you have a Goodix GTx8 touchscreen connected
	  to your system.

	  If unsure, say N.

	  To compile this driver as a module, choose M here: the
	  module will be called goodix_v1430_mmi.

config TOUCHSCREEN_GOODIX_GTX8_MMI_UPDATE
	tristate "Goodix GTx8 Moto touchpanel auto update support"
	depends on TOUCHSCREEN_GOODIX_GTX8_MMI
	default n
	help
	  This enables support for firmware update for Goodix GTx8
	  touchscreens.

	  Say Y here if you have a Goodix GTx8 touchscreen connected
	  to your system.

	  If unsure, say N.

	  To compile this driver as a module, choose M here: the
	  module will be called goodix_v1430_update_mmi.

config TOUCHSCREEN_GOODIX_GTX8_MMI_TOOLS
	tristate "Goodix GTx8 Moto touchpanel Tools"
	depends on TOUCHSCREEN_GOODIX_GTX8_MMI
	default n
	help
	  This is application debug interface support for Goodix GTx8
	  touchscreens.

	  If unsure, say N.

	  To compile this driver as a module, choose M here: the
	  module will be called goodix_v1430_ts_tools_mmi.
```

## drivers/input/touchscreen/synaptics_tcm_mmi_v2/Kconfig
```kconfig
#
# Synaptics TCM touchscreen driver configuration
#

menuconfig TOUCHSCREEN_SYNAPTICS_TCM_MMI
	bool "Synaptics TCM MMI touchscreen"
	default n
	help
	  Say Y here if you have a Moto Synaptics TCM touchscreen connected
	  to your system.

	  If unsure, say N.

if TOUCHSCREEN_SYNAPTICS_TCM_MMI

source "drivers/input/touchscreen/synaptics_tcm_mmi_v2/synaptics_bus/Kconfig"

source "drivers/input/touchscreen/synaptics_tcm_mmi_v2/synaptics_core/Kconfig"

source "drivers/input/touchscreen/synaptics_tcm_mmi_v2/synaptics_extmodules/Kconfig"

endif
```

## drivers/input/touchscreen/synaptics_tcm_mmi_v2/synaptics_bus/Kconfig
```kconfig
config TOUCHSCREEN_SYNAPTICS_TCM_MMI_I2C
	tristate "Synaptics I2C MMI"
	depends on I2C
	default n
	help
	  Say Y here to use I2C bus for communication.

	  Else, say N.

	  This will configure I2C bus for communicating
	  with touch controller.

config TOUCHSCREEN_SYNAPTICS_TCM_MMI_SPI
	tristate "Synaptics SPI MMI"
	depends on SPI_MASTER
	default n
	help
	  Say Y here to use SPI bus for communication.

	  Else, say N.

	  This will configure SPI bus for communicating
	  with touch controller.
```

## drivers/input/touchscreen/synaptics_tcm_mmi_v2/synaptics_core/Kconfig
```kconfig
config TOUCHSCREEN_SYNAPTICS_TCM_MMI_CORE
	tristate "Synaptics TCM core module"
	depends on I2C || SPI_MASTER
	default n
	help
	  Say Y here to enable core functionality.

	  If unsure, say N.

	  To compile this driver as a module, choose M here: the
	  module will be called synaptics_core_module.

config TOUCHSCREEN_SYNAPTICS_TCM_MMI_CORE_EMULATE_DT2W
	bool "Synaptics TCM core emulate dt2w"
	depends on I2C || SPI_MASTER
	depends on INPUT_TOUCHSCREEN_MMI
	depends on BOARD_USES_DOUBLE_TAP_CTRL
	default n
	help
	  Say Y here if you want to emulate double tap.

	  If unsure, say N.
```

## drivers/input/touchscreen/synaptics_tcm_mmi_v2/synaptics_extmodules/Kconfig
```kconfig
config TOUCHSCREEN_SYNAPTICS_TCM_MMI_DEVICE
	tristate "Synaptics TCM device module"
	depends on TOUCHSCREEN_SYNAPTICS_TCM_MMI_CORE
	default n
	help
	  Say Y here to enable support for TCM device functionality.

	  If unsure, say N.

	  To compile this driver as a module, choose M here: the
	  module will be called synaptics_tcm_device.

config TOUCHSCREEN_SYNAPTICS_TCM_MMI_TESTING
	tristate "Synaptics TCM testing module"
	depends on TOUCHSCREEN_SYNAPTICS_TCM_MMI_CORE
	default n
	help
	  Say Y here to enable support for testing functionality.

	  If unsure, say N.

	  To compile this driver as a module, choose M here: the
	  module will be called synaptics_tcm_testing.

config TOUCHSCREEN_SYNAPTICS_TCM_MMI_REFLASH
	tristate "Synaptics TCM reflash module"
	depends on TOUCHSCREEN_SYNAPTICS_TCM_MMI_CORE
	default n
	help
	  Say Y here to enable support for reflash functionality.

	  If unsure, say N.

	  To compile this driver as a module, choose M here: the
	  module will be called synaptics_tcm_reflash.

config TOUCHSCREEN_SYNAPTICS_TCM_MMI_RECOVERY
	tristate "Synaptics TCM recovery module"
	depends on TOUCHSCREEN_SYNAPTICS_TCM_MMI_CORE
	default n
	help
	  Say Y here to enable support for recovery functionality.

	  If unsure, say N.

	  To compile this driver as a module, choose M here: the
	  module will be called synaptics_tcm_recovery.

config TOUCHSCREEN_SYNAPTICS_TCM_MMI_ZEROFLASH
	tristate "Synaptics TCM zeroflash module"
	depends on TOUCHSCREEN_SYNAPTICS_TCM_MMI_CORE
	default n
	help
	  Say Y here to enable support for ZeroFlash functionality.

	  If unsure, say N.

	  To compile this driver as a module, choose M here: the
	  module will be called synaptics_tcm_zeroflash.

config TOUCHSCREEN_SYNAPTICS_TCM_MMI_DIAGNOSTICS
	tristate "Synaptics TCM diagnostics module"
	depends on TOUCHSCREEN_SYNAPTICS_TCM_MMI_CORE
	default n
	help
	  Say Y here to enable support for diagnostics functionality.

	  If unsure, say N.

	  To compile this driver as a module, choose M here: the
	  module will be called synaptics_tcm_diagnostics.

config TOUCHSCREEN_SYNAPTICS_TCM_MMI_GESTURES
	bool "Synaptics TCM Moto gestures"
	depends on TOUCHSCREEN_SYNAPTICS_TCM_MMI_CORE && INPUT_TOUCHSCREEN_MMI
	default n
	help
	  Say Y here to enable support for Moto gestures functionality.

	  If unsure, say N.

	  To compile this driver as a module, choose M here: the
	  module will be called synaptics_ts_mmi.
```

## drivers/power/bq27426_fg_mmi/Kconfig
```kconfig
config BQ27426_FG_MMI
	tristate "BQ27426 FG"
	default n
	help
	  Say Y here if you have a bq27426 fg compatible
	  device connected.

	  This driver can also be built as a module.  If so, the module
	  will be called bq27426_fg_mmi.

config ATL_4000MAH_8A_BATTERY_PROFILE
	bool "ATL 4000mAh 8A Battery Profile"
	default n

config SCUD_4000MAH_8A_BATTERY_PROFILE
	bool "SCUD 4000mAh 8A Battery Profile"
	default n

config ATL_LS40_1545MAH_BATTERY_PROFILE
	bool "ATL LS40 1545mAh Battery Profile"
	default n

config ATL_LS30_1255MAH_BATTERY_PROFILE
	bool "ATL LS30 1255mAh Battery Profile"
	default n

config ATL_NM40_712MAH_BATTERY_PROFILE
	bool "ATL NM40 712mAh Battery Profile"
	default n
```

## drivers/regulator/slg5bm43670/Kconfig
```kconfig
config REGULATOR_SLG5BM43670
	tristate "SLG5BM43670 REGULATOR"
	default n
	help
	  Say Y here if you have a SLG5BM43670 compatible
	  device connected.

	  This driver can also be built as a module.  If so, the module
	  will be called slg5bm43670-regulator.
```
