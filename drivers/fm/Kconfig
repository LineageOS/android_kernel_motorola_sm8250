## drivers/fm/Kconfig
```kconfig
config RADIO_ELNA
	tristate "ELNA FM Radio"
	default n
	help
	  Choose Y here if you have this FM radio chip.
```

## drivers/input/touchscreen/touchscreen_mmi/Kconfig
```kconfig
config INPUT_TOUCHSCREEN_MMI
	tristate "Moto touchscreen gestures"
	default n
	help
	 Say Y here if you wish to include support for Moto touchscreen gestures.
	 If unsure, say N.

config TOUCHCLASS_MMI_DEBUG_INFO
	bool "Moto touchscreen gestures debug info"
	depends on INPUT_TOUCHSCREEN_MMI
	default n
	help
	 Say Y here if you wish to include support for Moto touchscreen gestures debugging info.
	 If unsure, say N.

config TOUCHCLASS_MMI_GESTURE_POISON_EVENT
	bool "Moto gestures event poison"
	depends on INPUT_TOUCHSCREEN_MMI
	default n
	help
	 Say Y here if you wish to include support for Moto gestures event poison.
	 If unsure, say N.
```

## drivers/misc/awinic/aw8695/Kconfig
```kconfig
#
# AW8695 Driver
#

config AW8695_HAPTIC
	tristate "Awinic AW8695 haptic driver"
	depends on I2C && INPUT_AWINIC_HAPTIC
	help
	  Say Y here if you have Awinic AW8695 haptic controller
	  chip in your system.

	  If unsure, say N.

	  To compile this driver as a module, choose M here: the
	  module will be called aw8695.

config AW8965_VIBRATOR_SHORT_WAV_ENABLE
	bool "Awinic AW8695 haptic short wave"
	depends on AW8695_HAPTIC
	help
	  Say Y here if you want to have short wave support for AW8695.
	  If unsure, say N.
```

## drivers/power/qpnp_adaptive_charge/Kconfig
```kconfig
config QPNP_ADAPTIVE_CHARGE
        tristate "QPNP ADAPTIVE CHARGE"
        default n
        help
         Say Y here if you have a qpnp adaptive charge compatible
         device connected.

         This driver can also be built as a module.  If so, the module
         will be called qpnp_adaptive_charge.
```

## techpack/Kconfig
```kconfig
menu "Tech packages"

source "techpack/data/Kconfig"
source "techpack/display/Kconfig"

endmenu
```
